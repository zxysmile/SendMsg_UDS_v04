/*@@var:*/
variables
{
    // ------------------------------ variables for ECU----------------------------------//
    mstimer Timer1;
    message ECU_ResponseMsg    ECU_Response_Msg;

    enum CAN_TX_STEP{TX_PDU_READY=0, TX_FF, RX_FLOW_CONTROL, TX_CF, TX_PDU_OVER};
    byte ECU_TX_step = TX_PDU_READY;

    enum CAN_RX_STEP{RX_PDU_READY=0, RX_FF, TX_FLOW_CONTROL, RX_CF, RX_PDU_OVER};
    byte ECU_RX_step = RX_PDU_READY;

    byte ECU_RX_flag=0,ECU_CF_count=0,ECU_RX_length,total_length;

    // ------------------------------ variable for send PDU2 ----------------------------//
    struct multi_frame
    {
        byte single_buff[8];
        byte FF_buff[8];
        byte flow_control[8];
        byte CF_buff[35][8];    //max data = 6+7*35 = 251-->lengh+251byte = 252byte     
    }PDU1,PDU2;

    byte ECU_TX_buff[256],ECU_RX_OVER_flag=0,ECU_CF_count0,ECU_CF_count1,ms1_count,ECU_RX_flow_flag=0;
    byte ECU_RX_STmin_count = 0,ECU_RX_STmin_value,ECU_RX_BS_value=0;

    byte ReceiveSAmsg_Flag=0;
    
}
/*@@end*/

/*@@preStart:PreStart:*/
on preStart
{
    write("Welcome! ECU is ready for test!");
}
/*@@end*/

/*@@msg:CAN1.CAN_tester::Tester_FunReqMsg (0x600):*/
on message Tester_FunReqMsg
{
    ECU_Response_Msg.byte(0) = 0x02;
    ECU_Response_Msg.byte(1) = 0x7E;
    ECU_Response_Msg.byte(2) = 0x08;
    output(ECU_Response_Msg);
}
/*@@end*/

/*@@caplFunc:ECU_receive_PDU1():*///function
void ECU_receive_PDU1(void)
{
    switch(ECU_RX_step)
    {
        case RX_PDU_READY:
            ECU_RX_step = RX_FF;
        break;
        
        case RX_FF:
            if(ECU_RX_flag == 0x0F)             //single frame 
            {
                ECU_RX_flag = 0;
                ECU_RX_step = RX_PDU_OVER;
                if (ReceiveSAmsg_Flag)
                {
                    ReceiveSAmsg_Flag = 0x00;
                    ECU_Response_Msg.DLC = 0x08;
                    ECU_Response_Msg.Byte(0) = 0x06;
                    ECU_Response_Msg.Byte(1) = 0x67;
                    ECU_Response_Msg.Byte(2) = 0x02;
                    ECU_Response_Msg.Byte(3) = 0x12;
                    ECU_Response_Msg.Byte(4) = 0x34;
                    ECU_Response_Msg.Byte(5) = 0x56;
                    ECU_Response_Msg.Byte(6) = 0x78;
                    ECU_Response_Msg.Byte(7) = 0x00;
                    output(ECU_Response_Msg);
                }
            }
            else if(ECU_RX_flag == 0x1F)        //First Frame
            {
                ECU_RX_flag = 0;
                ECU_RX_length = ECU_RX_length + 6;
                ECU_RX_step = TX_FLOW_CONTROL;
            }
        break;
        
        case TX_FLOW_CONTROL:
            ECU_Response_Msg.DLC = 3;           // 8 or 3
            ECU_Response_Msg.byte(0) = 0x30;
            ECU_Response_Msg.byte(1) = 0x03;    //3 frames every
            ECU_Response_Msg.byte(2) = 10;      //10ms
            output(ECU_Response_Msg);
            
            ECU_CF_count = 3;
            ECU_RX_step = RX_CF;
        break;
        
        case RX_CF:
            if(ECU_RX_flag == 0x2F)             //receive one CF
            {
                ECU_RX_flag =0;
                
                if(ECU_CF_count--)
                {
                    ECU_RX_length = ECU_RX_length + 7;
                    if(ECU_RX_length >= total_length) 
                    {
                        ECU_RX_step = RX_PDU_OVER;
                    }
                }
                
                if(ECU_CF_count==0)
                {
                    if(ECU_RX_length >= total_length)
                    {
                        ECU_RX_step = RX_PDU_OVER;
                    }
                    else
                    {
                        ECU_RX_step = TX_FLOW_CONTROL;          //go on
                    }
                }
            }
        break;
        
        case RX_PDU_OVER:
            write("ECU RX PDU OVER!");
            ECU_RX_step = RX_FF;
            ECU_RX_length = 0;
            ECU_RX_OVER_flag = 1;
        break;

        default:
            ECU_RX_step = RX_PDU_READY;
            ECU_RX_length = 0;
            ECU_RX_OVER_flag = 1;
        break;
    }

}
/*@@end*/

/*@@timer:Timer1:*/
on timer Timer1
{
    ECU_receive_PDU1();

    ECU_send_PDU2();  

    if(ECU_RX_STmin_count) ECU_RX_STmin_count--;
    
    settimer(Timer1,1);
}
/*@@end*/

/*@@msg:CAN1.CAN_tester::TesterRequestMsg (0x620):*/
on message TesterRequestMsg
{
    if((this.byte(0)&0xF0) == 0x00)         //single frame
    {
        ECU_RX_flag = 0x0F;
        total_length = this.byte(0);
        if((this.byte(1) == 0x27) && (this.byte(2) == 0x01))
        {
            ReceiveSAmsg_Flag = 0x01;
        }
    }
    else if((this.byte(0)&0xF0) == 0x10)    //first frame
    {
        ECU_RX_flag = 0x1F;
        total_length = this.byte(1);
    }
    else if((this.byte(0)&0xF0) == 0x20)    //CF frame
    {
        ECU_RX_flag = 0x2F;
    }
    else if((this.byte(0)&0xF0) == 0x30)    //Flow control frame
    {
        ECU_RX_flow_flag = 1;
        
        ECU_RX_BS_value = this.byte(1);
        ECU_RX_STmin_value = this.byte(2);
        ECU_RX_STmin_count = ECU_RX_STmin_value;
    }    
}
/*@@end*/

/*@@caplFunc:ECU_send_PDU2():*///function
void ECU_send_PDU2(void)
{
    byte i,length;

    switch(ECU_TX_step)
    {
        case TX_PDU_READY:
            if(ECU_RX_OVER_flag)
            {
                ECU_RX_OVER_flag = 0;
                
                if(ECU_TX_buff[0]<8)        //single frame 
                {
                    PDU2.single_buff[0] = ECU_TX_buff[0];
                    for(i=0;i<7;i++) PDU2.single_buff[i+1] = ECU_TX_buff[i+1];
                }
                else                        //multi frame
                {
                    length = ECU_TX_buff[0];
                    PDU2.FF_buff[0] = 0x10;
                    PDU2.FF_buff[1] = ECU_TX_buff[0];
                    for(i=0;i<6;i++) PDU2.FF_buff[2+i] = ECU_TX_buff[1+i]; //FF
                    length = length-6;

                    ECU_CF_count0 = 0;
                    ECU_CF_count1 = 0;
                    while( length )
                    {
                        if(ECU_CF_count0<16)  PDU2.CF_buff[ECU_CF_count0][0] = 0x20 |((ECU_CF_count0+1)&0x0F);
                        else                  PDU2.CF_buff[ECU_CF_count0][0] = 0x20 | (ECU_CF_count0&0x0F);
          
                        for(i=0;i<7;i++) PDU2.CF_buff[ECU_CF_count0][1+i] = ECU_TX_buff[6+7*ECU_CF_count0+1+i];

                        ECU_CF_count0++;
                        if(length>7) length = length-7;
                        else length =0;
                    }
                }

                ECU_TX_step = TX_FF;
            }
        break;

        case TX_FF:
            if(PDU2.single_buff[0]>0)           // single msg 
            {
                //for(i=0;i<8;i++) ECU_Response_Msg.Byte(i) = PDU2.single_buff[i];


                ECU_TX_step = TX_PDU_OVER; 

            }
            else
            {
                for(i=0;i<8;i++) ECU_Response_Msg.Byte(i) = PDU2.FF_buff[i]; 
                ECU_TX_step = RX_FLOW_CONTROL; 
            }
            
            //output(ECU_Response_Msg);
            //write("Tester send first frame!");
        break;
        
        case RX_FLOW_CONTROL:
            if((ms1_count%50)==0)
            {
                //write("Tester is waiting for flow control!");
            }
            
            if(ECU_RX_flow_flag)
            {
                ECU_RX_flow_flag = 0;
                //get FS,BS,STmin
                //write("Tester received flow control!");
                ECU_TX_step = TX_CF; 
            }
        break;
        
        case TX_CF:
            if(ECU_RX_STmin_count==0)
            {
                ECU_RX_STmin_count = ECU_RX_STmin_value;

                if(ECU_RX_BS_value--)
                {
                    if(ECU_CF_count1 < ECU_CF_count0)
                    {
                        for(i=0;i<8;i++) ECU_Response_Msg.Byte(i) = PDU2.CF_buff[ ECU_CF_count1 ][i];                  
                        //output(ECU_Response_Msg);
                        ECU_CF_count1++;
                        //write("Tester send continue frame!");
                    }
                }
            
                if(ECU_CF_count1>=ECU_CF_count0) ECU_TX_step = TX_PDU_OVER;
                else if(ECU_RX_BS_value==0) ECU_TX_step = RX_FLOW_CONTROL;
            }
        break;

        case TX_PDU_OVER:
            //write("TX_PDU_OVER!");
            
            for(i=0;i<8;i++)
            {
                PDU2.single_buff[i] = 0;
                PDU2.FF_buff[i] = 0;
                PDU2.flow_control[i] = 0;
            }
            ECU_TX_step = TX_PDU_READY;
        break;

        default:
            for(i=0;i<8;i++)
            {
                PDU2.single_buff[i] = 0;
                PDU2.FF_buff[i] = 0;
                PDU2.flow_control[i] = 0;
            }
            ECU_TX_step = TX_PDU_READY;
        break;
    }

}
/*@@end*/

/*@@startStart:Start:*/
on start
{
    byte i;
    
    for(i=0;i<250;i++) ECU_TX_buff[i+1] = i;
    ECU_TX_buff[0] = 250;  //length
    
    settimer(Timer1,50);
}
/*@@end*/

